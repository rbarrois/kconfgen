## tests/kconf/Kconfig
```kconfig
# Root

choice SIDE
    prompt "Burger with a side of?"

    # Default
    config SIDE_FRIES
    bool "fries"

    config SIDE_SALAD
    bool "salad"

    config SIDE_FRIES_LOADED
    bool "loaded fries"
    depends on !DIET_VEGAN && !DIET_VEGETARIAN && !DIET_NO_MILK_BASED
    help
        Fries with bacon and melted cheddar.
endchoice

choice DIETARY_CONSTRAINTS
    prompt "Dietary constraints?"

    # Default
    config DIET_NONE
    bool "None"

    config DIET_NO_MILK_BASED
    bool "No milk-based products"

    config DIET_VEGETARIAN
    bool "Vegetarian"
    help
        No meat products, but eggs/milk OK

    config DIET_VEGAN
    bool "Vegan"
    help
        No animal-based products (inc. milk, ...)

endchoice

source "bread/Kconfig"
source "fillings/Kconfig"
```

## tests/kconf/bread/Kconfig
```kconfig
menu "bread"

choice BREAD
    prompt "Burger between slices of?"

    # Default
    config BREAD_STANDARD
    bool "standard"

    config BREAD_POTATO
    bool "potato"

    config BREAD_CHEESE
    bool "with cheese"
    depends on !DIET_VEGAN && !DIET_NO_MILK_BASED
endchoice

endmenu
```

## tests/kconf/fillings/Kconfig
```kconfig
menu "Fillings"

config CHEDDAR
    bool "Cheddar"
    default y
    depends on !DIET_VEGAN && !DIET_NO_MILK_BASED

config EXTRA_CHEDDAR
    bool "Extra cheddar"
    default n
    depends on CHEDDAR

choice STEAK
    prompt "Steak made of:"

    # Default
    config STEAK_BEEF
        bool "Beef"
        depends on !DIET_VEGAN && !DIET_VEGETARIAN

    config STEAK_CHICKEN
        bool "Chicken"
        depends on !DIET_VEGAN && !DIET_VEGETARIAN

    config STEAK_SOJA
        bool "Soja"
endchoice

choice STEAK_COOKING
    prompt "How cooked?"
    depends on STEAK_BEEF

    # Default
    config COOKED_MEDIUM
    bool "medium"

    config COOKED_RARE
    bool "rare"

    config COOKED_MEDIUM_RARE
    bool "medium-rare"

    config COOKED_WELL_DONE
    bool "well done"

    config COOKED_BURNT
    bool "burnt"
endchoice

source "fillings/extras/Kconfig"

endmenu
```

## tests/kconf/fillings/extras/Kconfig
```kconfig
menu "extras"

config SAUCE_MAYO
    bool "Mayo"
    default n

config SAUCE_KETCHUP
    bool "Ketchup"
    default y

config SAUCE_BLUE_CHEESE
    bool "Blue cheese"
    default n
    depends on !DIET_NO_MILK_BASED && !DIET_VEGAN

config PICKLES
    bool "Pickles"
    default n

config EGG
    bool "With an egg"
    default n
    depends on !DIET_VEGAN

endmenu
```
